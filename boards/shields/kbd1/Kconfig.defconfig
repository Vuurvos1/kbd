## boards/shields/kbd1/Kconfig.defconfig
```kconfig
# Copyright (c) 2024 The ZMK Contributors
# SPDX-License-Identifier: MIT

if SHIELD_KBD1_LEFT

config ZMK_KEYBOARD_NAME
    default "KBD1"

config ZMK_SPLIT_ROLE_CENTRAL
    default y

endif

if SHIELD_KBD1_LEFT || SHIELD_KBD1_RIGHT

config ZMK_SPLIT
    default y

endif
```
